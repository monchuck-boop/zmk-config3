## config/west.yml
```yaml
manifest:
  defaults:
    revision: main
  remotes:
    - name: zmkfirmware
      url-base: https://github.com
  projects:
    - name: zmk
      remote: zmkfirmware
      revision: main
      import: app/west.yml # ここはこのままでOK
  self:
    path: config
```
